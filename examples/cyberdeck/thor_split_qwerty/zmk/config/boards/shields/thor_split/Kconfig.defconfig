## examples/cyberdeck/thor_split_qwerty/zmk/config/boards/shields/thor_split/Kconfig.defconfig
```kconfig
if SHIELD_THOR_SPLIT_LEFT

config ZMK_KEYBOARD_NAME
    default "HS Thor Keys"

config ZMK_SPLIT_ROLE_CENTRAL
    default y

endif

if SHIELD_THOR_SPLIT_LEFT || SHIELD_THOR_SPLIT_RIGHT

config ZMK_SPLIT
    default y

endif
```

## examples/cyberdeck/thor_split_qwerty/zmk/config/boards/shields/thor_split/Kconfig.shield
```kconfig
config SHIELD_THOR_SPLIT_LEFT
    def_bool $(shields_list_contains,thor_split_left)

config SHIELD_THOR_SPLIT_RIGHT
    def_bool $(shields_list_contains,thor_split_right)
```
